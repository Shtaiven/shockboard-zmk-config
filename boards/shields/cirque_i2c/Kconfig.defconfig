## boards/shields/cirque_i2c/Kconfig.defconfig
```kconfig
if SHIELD_CIRQUE_I2C

config I2C
    default y

config INPUT
    default y

endif # SHIELD_CIRQUE_I2C
```

## boards/shields/cirque_spi/Kconfig.defconfig
```kconfig
if SHIELD_CIRQUE_SPI

config SPI
    default y

config INPUT
    default y

endif # SHIELD_CIRQUE_SPI
```

## boards/shields/glidepoint_fairyboard/Kconfig.shield
```kconfig
# Copyright (c) 2022 The ZMK Contributors
# SPDX-License-Identifier: MIT

config SHIELD_NICE_VIEW_ADAPTER_CUSTOM
    def_bool $(shields_list_contains,glidepoint_fairyboard)
```

## config/west.yml
```yaml
manifest:
  remotes:
    - name: zmkfirmware
      url-base: https://github.com/zmkfirmware
    - name: Shtaiven
      url-base: https://github.com/Shtaiven
    - name: petejohanson
      url-base: https://github.com/petejohanson
  projects:
    - name: zmk
      remote: zmkfirmware
      revision: v0.3
      import: app/west.yml
    - name: nice-view-fairyboard
      remote: Shtaiven
      revision: zmk-v0.2 # tag compatible with 0.3
    - name: cirque-input-module
      remote: petejohanson
      revision: main
  self:
    path: config
```
