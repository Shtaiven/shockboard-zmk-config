#include <behaviors.dtsi>
#include <input/processors.dtsi>
#include <dt-bindings/zmk/input_transform.h>
#include <dt-bindings/input/input-event-codes.h>

/{
    glidepoint_listener: glidepoint_listener {
        compatible = "zmk,input-listener";
        device = <&glidepoint>;

        // input-processors = <&zip_xy_transform (INPUT_TRANSFORM_XY_SWAP | INPUT_TRANSFORM_X_INVERT | INPUT_TRANSFORM_Y_INVERT) &zip_xy_scaler 10 4>;
    };
};
